/* Linker script for the decompressor prefix cut.
 *
 * The submitted binary is a self-extracting archive: a small stub unpacks the
 * compressor image into memory and runs it.  Only the DECOMPRESSOR half has
 * to be present in the shipped archive, so every function that only the
 * compressor can reach is collected in one section, .encoder_only, which is
 * placed behind the decompressor prefix.  Those bytes are then counted once
 * instead of twice.
 *
 * Each symbol is listed with all three possible prefixes (.text.,
 * .text.unlikely., .text.hot.).  Which one a function ends up in is decided by
 * the PGO profile; the symbol SET does not depend on the profile, only its
 * classification does.  Patterns that do not match are harmless to the linker.
 *
 * The build verifies the result: tools_src/packer/cut_dpath.py walks the
 * call graph from the decompressor entry point and aborts the build if any
 * function placed in .encoder_only is reachable from it.  A wrong entry here
 * would compress fine and crash only during verification. */
SECTIONS
{
  .encoder_only : {
    *(.text._ZN12preprocessor10Dictionary6EncodeEP8_IO_FILEiS2_ .text.unlikely._ZN12preprocessor10Dictionary6EncodeEP8_IO_FILEiS2_ .text.hot._ZN12preprocessor10Dictionary6EncodeEP8_IO_FILEiS2_)
    *(.text._ZN12preprocessor10Dictionary10EncodeWordERKNSt7__cxx1112basic_stringIcSt11char_traitsIcESaIcEEEibP8_IO_FILE .text.unlikely._ZN12preprocessor10Dictionary10EncodeWordERKNSt7__cxx1112basic_stringIcSt11char_traitsIcESaIcEEEibP8_IO_FILE .text.hot._ZN12preprocessor10Dictionary10EncodeWordERKNSt7__cxx1112basic_stringIcSt11char_traitsIcESaIcEEEibP8_IO_FILE)
    *(.text._ZN12preprocessor12_GLOBAL__N_111EncodeBytesEjP8_IO_FILE .text.unlikely._ZN12preprocessor12_GLOBAL__N_111EncodeBytesEjP8_IO_FILE .text.hot._ZN12preprocessor12_GLOBAL__N_111EncodeBytesEjP8_IO_FILE)
    *(.text._ZN12preprocessor10Dictionary15EncodeSubstringERKNSt7__cxx1112basic_stringIcSt11char_traitsIcESaIcEEEP8_IO_FILE .text.unlikely._ZN12preprocessor10Dictionary15EncodeSubstringERKNSt7__cxx1112basic_stringIcSt11char_traitsIcESaIcEEEP8_IO_FILE .text.hot._ZN12preprocessor10Dictionary15EncodeSubstringERKNSt7__cxx1112basic_stringIcSt11char_traitsIcESaIcEEEP8_IO_FILE)
    *(.text._ZN10r1_reorder22ReorderEncodedTailFileERKNSt7__cxx1112basic_stringIcSt11char_traitsIcESaIcEEES7_ .text.unlikely._ZN10r1_reorder22ReorderEncodedTailFileERKNSt7__cxx1112basic_stringIcSt11char_traitsIcESaIcEEES7_ .text.hot._ZN10r1_reorder22ReorderEncodedTailFileERKNSt7__cxx1112basic_stringIcSt11char_traitsIcESaIcEEES7_)
    *(.text._Z11WriteHeaderyRKSt6vectorIbSaIbEEbPSt14basic_ofstreamIcSt11char_traitsIcEE .text.unlikely._Z11WriteHeaderyRKSt6vectorIbSaIbEEbPSt14basic_ofstreamIcSt11char_traitsIcEE .text.hot._Z11WriteHeaderyRKSt6vectorIbSaIbEEbPSt14basic_ofstreamIcSt11char_traitsIcEE)
    *(.text._Z14RunCompressionbRKNSt7__cxx1112basic_stringIcSt11char_traitsIcESaIcEEES6_S6_P8_IO_FILEPyS9_PKc .text.unlikely._Z14RunCompressionbRKNSt7__cxx1112basic_stringIcSt11char_traitsIcESaIcEEES6_S6_P8_IO_FILEPyS9_PKc .text.hot._Z14RunCompressionbRKNSt7__cxx1112basic_stringIcSt11char_traitsIcESaIcEEES6_S6_P8_IO_FILEPyS9_PKc)
    *(.text._ZN12preprocessor12NoPreprocessEP8_IO_FILES1_y .text.unlikely._ZN12preprocessor12NoPreprocessEP8_IO_FILES1_y .text.hot._ZN12preprocessor12NoPreprocessEP8_IO_FILES1_y)
    *(.text._Z12ExtractVocabyPSt14basic_ifstreamIcSt11char_traitsIcEEPSt6vectorIbSaIbEE .text.unlikely._Z12ExtractVocabyPSt14basic_ifstreamIcSt11char_traitsIcEEPSt6vectorIbSaIbEE .text.hot._Z12ExtractVocabyPSt14basic_ifstreamIcSt11char_traitsIcEEPSt6vectorIbSaIbEE)
    *(.text._Z8CompressyPSt14basic_ifstreamIcSt11char_traitsIcEEPSt14basic_ofstreamIcS1_EPyP9Predictor .text.unlikely._Z8CompressyPSt14basic_ifstreamIcSt11char_traitsIcEEPSt14basic_ofstreamIcS1_EPyP9Predictor .text.hot._Z8CompressyPSt14basic_ifstreamIcSt11char_traitsIcEEPSt14basic_ofstreamIcS1_EPyP9Predictor)
    *(.text._ZNSt6vectorIdSaIdEEC2EmRKS0_ .text.unlikely._ZNSt6vectorIdSaIdEEC2EmRKS0_ .text.hot._ZNSt6vectorIdSaIdEEC2EmRKS0_)
    *(.text._ZN12preprocessor6EncodeEP8_IO_FILES1_yRKNSt7__cxx1112basic_stringIcSt11char_traitsIcESaIcEEES1_ .text.unlikely._ZN12preprocessor6EncodeEP8_IO_FILES1_yRKNSt7__cxx1112basic_stringIcSt11char_traitsIcESaIcEEES1_ .text.hot._ZN12preprocessor6EncodeEP8_IO_FILES1_yRKNSt7__cxx1112basic_stringIcSt11char_traitsIcESaIcEEES1_)
    *(.text._ZN12preprocessor13EncodeSegmentEP8_IO_FILES1_iRKNSt7__cxx1112basic_stringIcSt11char_traitsIcESaIcEEES1_PSt6vectorIdSaIdEE .text.unlikely._ZN12preprocessor13EncodeSegmentEP8_IO_FILES1_iRKNSt7__cxx1112basic_stringIcSt11char_traitsIcESaIcEEES1_PSt6vectorIdSaIdEE .text.hot._ZN12preprocessor13EncodeSegmentEP8_IO_FILES1_iRKNSt7__cxx1112basic_stringIcSt11char_traitsIcESaIcEEES1_PSt6vectorIdSaIdEE)
    *(.text._ZN12preprocessor6detectEP8_IO_FILEiNS_8FiletypeE .text.unlikely._ZN12preprocessor6detectEP8_IO_FILEiNS_8FiletypeE .text.hot._ZN12preprocessor6detectEP8_IO_FILEiNS_8FiletypeE)
    *(.text._ZN12preprocessor11encode_textEP8_IO_FILES1_iNSt7__cxx1112basic_stringIcSt11char_traitsIcESaIcEEES1_ .text.unlikely._ZN12preprocessor11encode_textEP8_IO_FILES1_iNSt7__cxx1112basic_stringIcSt11char_traitsIcESaIcEEES1_ .text.hot._ZN12preprocessor11encode_textEP8_IO_FILES1_iNSt7__cxx1112basic_stringIcSt11char_traitsIcESaIcEEES1_)
    *(.text._ZNSt6thread11_State_implINS_8_InvokerISt5tupleIJPFvvEEEEEE6_M_runEv .text.unlikely._ZNSt6thread11_State_implINS_8_InvokerISt5tupleIJPFvvEEEEEE6_M_runEv .text.hot._ZNSt6thread11_State_implINS_8_InvokerISt5tupleIJPFvvEEEEEE6_M_runEv)
    *(.text._ZNSt11unique_lockISt5mutexE4lockEv .text.unlikely._ZNSt11unique_lockISt5mutexE4lockEv .text.hot._ZNSt11unique_lockISt5mutexE4lockEv)
    *(.text._ZNSt6threadC2IRFvvEJEvEEOT_DpOT0_ .text.unlikely._ZNSt6threadC2IRFvvEJEvEEOT_DpOT0_ .text.hot._ZNSt6threadC2IRFvvEJEvEEOT_DpOT0_)
    *(.text._ZN10r1_reorder12_GLOBAL__N_113Fast2CmpBlockEPKvS2_Pv .text.unlikely._ZN10r1_reorder12_GLOBAL__N_113Fast2CmpBlockEPKvS2_Pv .text.hot._ZN10r1_reorder12_GLOBAL__N_113Fast2CmpBlockEPKvS2_Pv)
    *(.text._ZN10r1_reorder12_GLOBAL__N_112AppendVarintEPNS0_7ByteBufEm .text.unlikely._ZN10r1_reorder12_GLOBAL__N_112AppendVarintEPNS0_7ByteBufEm .text.hot._ZN10r1_reorder12_GLOBAL__N_112AppendVarintEPNS0_7ByteBufEm)
    *(.text._Z7reorderv .text.unlikely._Z7reorderv .text.hot._Z7reorderv)
    *(.text._Z5writePKcR10HeaderInfo .text.unlikely._Z5writePKcR10HeaderInfo .text.hot._Z5writePKcR10HeaderInfo)
    *(.text._Z4readPKcR10HeaderInfo .text.unlikely._Z4readPKcR10HeaderInfo .text.hot._Z4readPKcR10HeaderInfo)
    *(.text._Z16selfextract_compv .text.unlikely._Z16selfextract_compv .text.hot._Z16selfextract_compv)
    *(.text._Z8wctoutf8Pcj .text.unlikely._Z8wctoutf8Pcj .text.hot._Z8wctoutf8Pcj)
    *(.text._Z4hentPcS_ .text.unlikely._Z4hentPcS_ .text.hot._Z4hentPcS_)
    *(.text._Z5hent2PcS_ .text.unlikely._Z5hent2PcS_ .text.hot._Z5hent2PcS_)
    *(.text._Z5hent5PcS_ .text.unlikely._Z5hent5PcS_ .text.hot._Z5hent5PcS_)
    *(.text._Z8henttailPcS_P8_IO_FILE .text.unlikely._Z8henttailPcS_P8_IO_FILE .text.hot._Z8henttailPcS_P8_IO_FILE)
    *(.text._Z14encode_txt_witP8_IO_FILES0_ .text.unlikely._Z14encode_txt_witP8_IO_FILES0_ .text.hot._Z14encode_txt_witP8_IO_FILES0_)
    *(.text._Z11phda9_preprv .text.unlikely._Z11phda9_preprv .text.hot._Z11phda9_preprv)
    *(.text._Z10split4CompPKc .text.unlikely._Z10split4CompPKc .text.hot._Z10split4CompPKc)
    *(.text._Z11getFileSizeRKNSt7__cxx1112basic_stringIcSt11char_traitsIcESaIcEEE .text.unlikely._Z11getFileSizeRKNSt7__cxx1112basic_stringIcSt11char_traitsIcESaIcEEE .text.hot._Z11getFileSizeRKNSt7__cxx1112basic_stringIcSt11char_traitsIcESaIcEEE)
    *(.text._ZNSt6vectorIcSaIcEEC2EmRKS0_ .text.unlikely._ZNSt6vectorIcSaIcEEC2EmRKS0_ .text.hot._ZNSt6vectorIcSaIcEEC2EmRKS0_)
    *(.text._ZN3ord9Extractor4LineERKNSt7__cxx1112basic_stringIcSt11char_traitsIcESaIcEEEPNS_8PageScanE .text.unlikely._ZN3ord9Extractor4LineERKNSt7__cxx1112basic_stringIcSt11char_traitsIcESaIcEEEPNS_8PageScanE .text.hot._ZN3ord9Extractor4LineERKNSt7__cxx1112basic_stringIcSt11char_traitsIcESaIcEEEPNS_8PageScanE)
    *(.text._ZNSt6vectorIS_IiSaIiEESaIS1_EEC2EmRKS2_ .text.unlikely._ZNSt6vectorIS_IiSaIiEESaIS1_EEC2EmRKS2_ .text.hot._ZNSt6vectorIS_IiSaIiEESaIS1_EEC2EmRKS2_)
    *(.text._ZNSt6vectorIlSaIlEEC2EmRKS0_ .text.unlikely._ZNSt6vectorIlSaIlEEC2EmRKS0_ .text.hot._ZNSt6vectorIlSaIlEEC2EmRKS0_)
    *(.text._ZN3ord9ORDV3Vote4InitEiRKSt6vectorIiSaIiEE .text.unlikely._ZN3ord9ORDV3Vote4InitEiRKSt6vectorIiSaIiEE .text.hot._ZN3ord9ORDV3Vote4InitEiRKSt6vectorIiSaIiEE)
    *(.text._ZN3ord9ORDV3Vote5ScoreEiRKSt6vectorImSaImEERKS1_IS1_IiSaIiEESaIS7_EERKS1_IlSaIlEERKS7_i .text.unlikely._ZN3ord9ORDV3Vote5ScoreEiRKSt6vectorImSaImEERKS1_IS1_IiSaIiEESaIS7_EERKS1_IlSaIlEERKS7_i .text.hot._ZN3ord9ORDV3Vote5ScoreEiRKSt6vectorImSaImEERKS1_IS1_IiSaIiEESaIS7_EERKS1_IlSaIlEERKS7_i)
    *(.text._ZNSt6vectorIS_IiSaIiEESaIS1_EED2Ev .text.unlikely._ZNSt6vectorIS_IiSaIiEESaIS1_EED2Ev .text.hot._ZNSt6vectorIS_IiSaIiEESaIS1_EED2Ev)
    *(.text._ZN3ord9ORDV3VoteD2Ev .text.unlikely._ZN3ord9ORDV3VoteD2Ev .text.hot._ZN3ord9ORDV3VoteD2Ev)
    *(.text._ZN3ord8ResidualD2Ev .text.unlikely._ZN3ord8ResidualD2Ev .text.hot._ZN3ord8ResidualD2Ev)
    
    *(.text._ZNSt6vectorIiSaIiEE17_M_realloc_insertIJiEEEvN9__gnu_cxx17__normal_iteratorIPiS1_EEDpOT_ .text.unlikely._ZNSt6vectorIiSaIiEE17_M_realloc_insertIJiEEEvN9__gnu_cxx17__normal_iteratorIPiS1_EEDpOT_ .text.hot._ZNSt6vectorIiSaIiEE17_M_realloc_insertIJiEEEvN9__gnu_cxx17__normal_iteratorIPiS1_EEDpOT_)
    *(.text._ZNSt6vectorISt4pairIihESaIS1_EE17_M_realloc_insertIJS1_EEEvN9__gnu_cxx17__normal_iteratorIPS1_S3_EEDpOT_ .text.unlikely._ZNSt6vectorISt4pairIihESaIS1_EE17_M_realloc_insertIJS1_EEEvN9__gnu_cxx17__normal_iteratorIPS1_S3_EEDpOT_ .text.hot._ZNSt6vectorISt4pairIihESaIS1_EE17_M_realloc_insertIJS1_EEEvN9__gnu_cxx17__normal_iteratorIPS1_S3_EEDpOT_)
    *(.text._ZNSt10_HashtableIiSt4pairIKihESaIS2_ENSt8__detail10_Select1stESt8equal_toIiESt4hashIiENS4_18_Mod_range_hashingENS4_20_Default_ranged_hashENS4_20_Prime_rehash_policyENS4_17_Hashtable_traitsILb0ELb0ELb1EEEEC2IN9__gnu_cxx17__normal_iteratorIPS0_IihESt6vectorISJ_SaISJ_EEEEEET_SP_mRKS9_RKS7_RKS3_St17integral_constantIbLb1EE .text.unlikely._ZNSt10_HashtableIiSt4pairIKihESaIS2_ENSt8__detail10_Select1stESt8equal_toIiESt4hashIiENS4_18_Mod_range_hashingENS4_20_Default_ranged_hashENS4_20_Prime_rehash_policyENS4_17_Hashtable_traitsILb0ELb0ELb1EEEEC2IN9__gnu_cxx17__normal_iteratorIPS0_IihESt6vectorISJ_SaISJ_EEEEEET_SP_mRKS9_RKS7_RKS3_St17integral_constantIbLb1EE .text.hot._ZNSt10_HashtableIiSt4pairIKihESaIS2_ENSt8__detail10_Select1stESt8equal_toIiESt4hashIiENS4_18_Mod_range_hashingENS4_20_Default_ranged_hashENS4_20_Prime_rehash_policyENS4_17_Hashtable_traitsILb0ELb0ELb1EEEEC2IN9__gnu_cxx17__normal_iteratorIPS0_IihESt6vectorISJ_SaISJ_EEEEEET_SP_mRKS9_RKS7_RKS3_St17integral_constantIbLb1EE)
    *(.text._ZNSt10_HashtableIiSt4pairIKihESaIS2_ENSt8__detail10_Select1stESt8equal_toIiESt4hashIiENS4_18_Mod_range_hashingENS4_20_Default_ranged_hashENS4_20_Prime_rehash_policyENS4_17_Hashtable_traitsILb0ELb0ELb1EEEEC2EmRKS9_RKS7_RKS3_ .text.unlikely._ZNSt10_HashtableIiSt4pairIKihESaIS2_ENSt8__detail10_Select1stESt8equal_toIiESt4hashIiENS4_18_Mod_range_hashingENS4_20_Default_ranged_hashENS4_20_Prime_rehash_policyENS4_17_Hashtable_traitsILb0ELb0ELb1EEEEC2EmRKS9_RKS7_RKS3_ .text.hot._ZNSt10_HashtableIiSt4pairIKihESaIS2_ENSt8__detail10_Select1stESt8equal_toIiESt4hashIiENS4_18_Mod_range_hashingENS4_20_Default_ranged_hashENS4_20_Prime_rehash_policyENS4_17_Hashtable_traitsILb0ELb0ELb1EEEEC2EmRKS9_RKS7_RKS3_)
    *(.text._ZNSt10_HashtableIiSt4pairIKihESaIS2_ENSt8__detail10_Select1stESt8equal_toIiESt4hashIiENS4_18_Mod_range_hashingENS4_20_Default_ranged_hashENS4_20_Prime_rehash_policyENS4_17_Hashtable_traitsILb0ELb0ELb1EEEE16_M_insert_uniqueIRS1_RKS0_IihENS4_10_AllocNodeISaINS4_10_Hash_nodeIS2_Lb0EEEEEEEES0_INS4_14_Node_iteratorIS2_Lb0ELb0EEEbEOT_OT0_RKT1_ .text.unlikely._ZNSt10_HashtableIiSt4pairIKihESaIS2_ENSt8__detail10_Select1stESt8equal_toIiESt4hashIiENS4_18_Mod_range_hashingENS4_20_Default_ranged_hashENS4_20_Prime_rehash_policyENS4_17_Hashtable_traitsILb0ELb0ELb1EEEE16_M_insert_uniqueIRS1_RKS0_IihENS4_10_AllocNodeISaINS4_10_Hash_nodeIS2_Lb0EEEEEEEES0_INS4_14_Node_iteratorIS2_Lb0ELb0EEEbEOT_OT0_RKT1_ .text.hot._ZNSt10_HashtableIiSt4pairIKihESaIS2_ENSt8__detail10_Select1stESt8equal_toIiESt4hashIiENS4_18_Mod_range_hashingENS4_20_Default_ranged_hashENS4_20_Prime_rehash_policyENS4_17_Hashtable_traitsILb0ELb0ELb1EEEE16_M_insert_uniqueIRS1_RKS0_IihENS4_10_AllocNodeISaINS4_10_Hash_nodeIS2_Lb0EEEEEEEES0_INS4_14_Node_iteratorIS2_Lb0ELb0EEEbEOT_OT0_RKT1_)
    *(.text._ZNKSt10_HashtableIiSt4pairIKihESaIS2_ENSt8__detail10_Select1stESt8equal_toIiESt4hashIiENS4_18_Mod_range_hashingENS4_20_Default_ranged_hashENS4_20_Prime_rehash_policyENS4_17_Hashtable_traitsILb0ELb0ELb1EEEE15_M_find_node_trIiEEPNS4_10_Hash_nodeIS2_Lb0EEEmRKT_m .text.unlikely._ZNKSt10_HashtableIiSt4pairIKihESaIS2_ENSt8__detail10_Select1stESt8equal_toIiESt4hashIiENS4_18_Mod_range_hashingENS4_20_Default_ranged_hashENS4_20_Prime_rehash_policyENS4_17_Hashtable_traitsILb0ELb0ELb1EEEE15_M_find_node_trIiEEPNS4_10_Hash_nodeIS2_Lb0EEEmRKT_m .text.hot._ZNKSt10_HashtableIiSt4pairIKihESaIS2_ENSt8__detail10_Select1stESt8equal_toIiESt4hashIiENS4_18_Mod_range_hashingENS4_20_Default_ranged_hashENS4_20_Prime_rehash_policyENS4_17_Hashtable_traitsILb0ELb0ELb1EEEE15_M_find_node_trIiEEPNS4_10_Hash_nodeIS2_Lb0EEEmRKT_m)
    *(.text._ZNSt10_HashtableIiSt4pairIKihESaIS2_ENSt8__detail10_Select1stESt8equal_toIiESt4hashIiENS4_18_Mod_range_hashingENS4_20_Default_ranged_hashENS4_20_Prime_rehash_policyENS4_17_Hashtable_traitsILb0ELb0ELb1EEEE21_M_insert_unique_nodeEmmPNS4_10_Hash_nodeIS2_Lb0EEEm .text.unlikely._ZNSt10_HashtableIiSt4pairIKihESaIS2_ENSt8__detail10_Select1stESt8equal_toIiESt4hashIiENS4_18_Mod_range_hashingENS4_20_Default_ranged_hashENS4_20_Prime_rehash_policyENS4_17_Hashtable_traitsILb0ELb0ELb1EEEE21_M_insert_unique_nodeEmmPNS4_10_Hash_nodeIS2_Lb0EEEm .text.hot._ZNSt10_HashtableIiSt4pairIKihESaIS2_ENSt8__detail10_Select1stESt8equal_toIiESt4hashIiENS4_18_Mod_range_hashingENS4_20_Default_ranged_hashENS4_20_Prime_rehash_policyENS4_17_Hashtable_traitsILb0ELb0ELb1EEEE21_M_insert_unique_nodeEmmPNS4_10_Hash_nodeIS2_Lb0EEEm)
    *(.text._ZNSt10_HashtableIiSt4pairIKihESaIS2_ENSt8__detail10_Select1stESt8equal_toIiESt4hashIiENS4_18_Mod_range_hashingENS4_20_Default_ranged_hashENS4_20_Prime_rehash_policyENS4_17_Hashtable_traitsILb0ELb0ELb1EEEE13_M_rehash_auxEmSt17integral_constantIbLb1EE .text.unlikely._ZNSt10_HashtableIiSt4pairIKihESaIS2_ENSt8__detail10_Select1stESt8equal_toIiESt4hashIiENS4_18_Mod_range_hashingENS4_20_Default_ranged_hashENS4_20_Prime_rehash_policyENS4_17_Hashtable_traitsILb0ELb0ELb1EEEE13_M_rehash_auxEmSt17integral_constantIbLb1EE .text.hot._ZNSt10_HashtableIiSt4pairIKihESaIS2_ENSt8__detail10_Select1stESt8equal_toIiESt4hashIiENS4_18_Mod_range_hashingENS4_20_Default_ranged_hashENS4_20_Prime_rehash_policyENS4_17_Hashtable_traitsILb0ELb0ELb1EEEE13_M_rehash_auxEmSt17integral_constantIbLb1EE)
    *(.text._ZNSt6vectorIcSaIcEE14_M_fill_insertEN9__gnu_cxx17__normal_iteratorIPcS1_EEmRKc .text.unlikely._ZNSt6vectorIcSaIcEE14_M_fill_insertEN9__gnu_cxx17__normal_iteratorIPcS1_EEmRKc .text.hot._ZNSt6vectorIcSaIcEE14_M_fill_insertEN9__gnu_cxx17__normal_iteratorIPcS1_EEmRKc)
    *(.text._ZN3ord9Extractor5TitleEPKcS2_ .text.unlikely._ZN3ord9Extractor5TitleEPKcS2_ .text.hot._ZN3ord9Extractor5TitleEPKcS2_)
    *(.text._ZN3ord9Extractor9FlagsLineEPKcm .text.unlikely._ZN3ord9Extractor9FlagsLineEPKcm .text.hot._ZN3ord9Extractor9FlagsLineEPKcm)
    *(.text._ZN3ord9Extractor8LeadLineEPKcm .text.unlikely._ZN3ord9Extractor8LeadLineEPKcm .text.hot._ZN3ord9Extractor8LeadLineEPKcm)
    *(.text._ZN3ord9Extractor9FeatsLineEPKcm .text.unlikely._ZN3ord9Extractor9FeatsLineEPKcm .text.hot._ZN3ord9Extractor9FeatsLineEPKcm)
    *(.text._ZSt6__sortIN9__gnu_cxx17__normal_iteratorIPmSt6vectorImSaImEEEENS0_5__ops15_Iter_less_iterEEvT_S9_T0_ .text.unlikely._ZSt6__sortIN9__gnu_cxx17__normal_iteratorIPmSt6vectorImSaImEEEENS0_5__ops15_Iter_less_iterEEvT_S9_T0_ .text.hot._ZSt6__sortIN9__gnu_cxx17__normal_iteratorIPmSt6vectorImSaImEEEENS0_5__ops15_Iter_less_iterEEvT_S9_T0_)
    *(.text._ZSt16__introsort_loopIN9__gnu_cxx17__normal_iteratorIPmSt6vectorImSaImEEEElNS0_5__ops15_Iter_less_iterEEvT_S9_T0_T1_ .text.unlikely._ZSt16__introsort_loopIN9__gnu_cxx17__normal_iteratorIPmSt6vectorImSaImEEEElNS0_5__ops15_Iter_less_iterEEvT_S9_T0_T1_ .text.hot._ZSt16__introsort_loopIN9__gnu_cxx17__normal_iteratorIPmSt6vectorImSaImEEEElNS0_5__ops15_Iter_less_iterEEvT_S9_T0_T1_)
    *(.text._ZSt22__final_insertion_sortIN9__gnu_cxx17__normal_iteratorIPmSt6vectorImSaImEEEENS0_5__ops15_Iter_less_iterEEvT_S9_T0_ .text.unlikely._ZSt22__final_insertion_sortIN9__gnu_cxx17__normal_iteratorIPmSt6vectorImSaImEEEENS0_5__ops15_Iter_less_iterEEvT_S9_T0_ .text.hot._ZSt22__final_insertion_sortIN9__gnu_cxx17__normal_iteratorIPmSt6vectorImSaImEEEENS0_5__ops15_Iter_less_iterEEvT_S9_T0_)
    *(.text._ZSt14__partial_sortIN9__gnu_cxx17__normal_iteratorIPmSt6vectorImSaImEEEENS0_5__ops15_Iter_less_iterEEvT_S9_S9_T0_ .text.unlikely._ZSt14__partial_sortIN9__gnu_cxx17__normal_iteratorIPmSt6vectorImSaImEEEENS0_5__ops15_Iter_less_iterEEvT_S9_S9_T0_ .text.hot._ZSt14__partial_sortIN9__gnu_cxx17__normal_iteratorIPmSt6vectorImSaImEEEENS0_5__ops15_Iter_less_iterEEvT_S9_S9_T0_)
    *(.text._ZSt27__unguarded_partition_pivotIN9__gnu_cxx17__normal_iteratorIPmSt6vectorImSaImEEEENS0_5__ops15_Iter_less_iterEET_S9_S9_T0_ .text.unlikely._ZSt27__unguarded_partition_pivotIN9__gnu_cxx17__normal_iteratorIPmSt6vectorImSaImEEEENS0_5__ops15_Iter_less_iterEET_S9_S9_T0_ .text.hot._ZSt27__unguarded_partition_pivotIN9__gnu_cxx17__normal_iteratorIPmSt6vectorImSaImEEEENS0_5__ops15_Iter_less_iterEET_S9_S9_T0_)
    *(.text._ZSt13__heap_selectIN9__gnu_cxx17__normal_iteratorIPmSt6vectorImSaImEEEENS0_5__ops15_Iter_less_iterEEvT_S9_S9_T0_ .text.unlikely._ZSt13__heap_selectIN9__gnu_cxx17__normal_iteratorIPmSt6vectorImSaImEEEENS0_5__ops15_Iter_less_iterEEvT_S9_S9_T0_ .text.hot._ZSt13__heap_selectIN9__gnu_cxx17__normal_iteratorIPmSt6vectorImSaImEEEENS0_5__ops15_Iter_less_iterEEvT_S9_S9_T0_)
    *(.text._ZSt11__make_heapIN9__gnu_cxx17__normal_iteratorIPmSt6vectorImSaImEEEENS0_5__ops15_Iter_less_iterEEvT_S9_RT0_ .text.unlikely._ZSt11__make_heapIN9__gnu_cxx17__normal_iteratorIPmSt6vectorImSaImEEEENS0_5__ops15_Iter_less_iterEEvT_S9_RT0_ .text.hot._ZSt11__make_heapIN9__gnu_cxx17__normal_iteratorIPmSt6vectorImSaImEEEENS0_5__ops15_Iter_less_iterEEvT_S9_RT0_)
    *(.text._ZSt13__adjust_heapIN9__gnu_cxx17__normal_iteratorIPmSt6vectorImSaImEEEElmNS0_5__ops15_Iter_less_iterEEvT_T0_SA_T1_T2_ .text.unlikely._ZSt13__adjust_heapIN9__gnu_cxx17__normal_iteratorIPmSt6vectorImSaImEEEElmNS0_5__ops15_Iter_less_iterEEvT_T0_SA_T1_T2_ .text.hot._ZSt13__adjust_heapIN9__gnu_cxx17__normal_iteratorIPmSt6vectorImSaImEEEElmNS0_5__ops15_Iter_less_iterEEvT_T0_SA_T1_T2_)
    *(.text._ZSt22__move_median_to_firstIN9__gnu_cxx17__normal_iteratorIPmSt6vectorImSaImEEEENS0_5__ops15_Iter_less_iterEEvT_S9_S9_S9_T0_ .text.unlikely._ZSt22__move_median_to_firstIN9__gnu_cxx17__normal_iteratorIPmSt6vectorImSaImEEEENS0_5__ops15_Iter_less_iterEEvT_S9_S9_S9_T0_ .text.hot._ZSt22__move_median_to_firstIN9__gnu_cxx17__normal_iteratorIPmSt6vectorImSaImEEEENS0_5__ops15_Iter_less_iterEEvT_S9_S9_S9_T0_)
    *(.text._ZSt16__insertion_sortIN9__gnu_cxx17__normal_iteratorIPmSt6vectorImSaImEEEENS0_5__ops15_Iter_less_iterEEvT_S9_T0_ .text.unlikely._ZSt16__insertion_sortIN9__gnu_cxx17__normal_iteratorIPmSt6vectorImSaImEEEENS0_5__ops15_Iter_less_iterEEvT_S9_T0_ .text.hot._ZSt16__insertion_sortIN9__gnu_cxx17__normal_iteratorIPmSt6vectorImSaImEEEENS0_5__ops15_Iter_less_iterEEvT_S9_T0_)
    *(.text._ZSt8__uniqueIN9__gnu_cxx17__normal_iteratorIPmSt6vectorImSaImEEEENS0_5__ops19_Iter_equal_to_iterEET_S9_S9_T0_ .text.unlikely._ZSt8__uniqueIN9__gnu_cxx17__normal_iteratorIPmSt6vectorImSaImEEEENS0_5__ops19_Iter_equal_to_iterEET_S9_S9_T0_ .text.hot._ZSt8__uniqueIN9__gnu_cxx17__normal_iteratorIPmSt6vectorImSaImEEEENS0_5__ops19_Iter_equal_to_iterEET_S9_S9_T0_)
    *(.text._ZNSt10_HashtableIiSt4pairIKihESaIS2_ENSt8__detail10_Select1stESt8equal_toIiESt4hashIiENS4_18_Mod_range_hashingENS4_20_Default_ranged_hashENS4_20_Prime_rehash_policyENS4_17_Hashtable_traitsILb0ELb0ELb1EEEE4findERS1_ .text.unlikely._ZNSt10_HashtableIiSt4pairIKihESaIS2_ENSt8__detail10_Select1stESt8equal_toIiESt4hashIiENS4_18_Mod_range_hashingENS4_20_Default_ranged_hashENS4_20_Prime_rehash_policyENS4_17_Hashtable_traitsILb0ELb0ELb1EEEE4findERS1_ .text.hot._ZNSt10_HashtableIiSt4pairIKihESaIS2_ENSt8__detail10_Select1stESt8equal_toIiESt4hashIiENS4_18_Mod_range_hashingENS4_20_Default_ranged_hashENS4_20_Prime_rehash_policyENS4_17_Hashtable_traitsILb0ELb0ELb1EEEE4findERS1_)
    *(.text._ZNSt6vectorIS_ImSaImEESaIS1_EE12emplace_backIJS1_EEERS1_DpOT_ .text.unlikely._ZNSt6vectorIS_ImSaImEESaIS1_EE12emplace_backIJS1_EEERS1_DpOT_ .text.hot._ZNSt6vectorIS_ImSaImEESaIS1_EE12emplace_backIJS1_EEERS1_DpOT_)
    *(.text._ZNSt6vectorIS_ImSaImEESaIS1_EE17_M_realloc_insertIJS1_EEEvN9__gnu_cxx17__normal_iteratorIPS1_S3_EEDpOT_ .text.unlikely._ZNSt6vectorIS_ImSaImEESaIS1_EE17_M_realloc_insertIJS1_EEEvN9__gnu_cxx17__normal_iteratorIPS1_S3_EEDpOT_ .text.hot._ZNSt6vectorIS_ImSaImEESaIS1_EE17_M_realloc_insertIJS1_EEEvN9__gnu_cxx17__normal_iteratorIPS1_S3_EEDpOT_)
    *(.text._ZNSt15__new_allocatorISt6vectorImSaImEEE8allocateEmPKv .text.unlikely._ZNSt15__new_allocatorISt6vectorImSaImEEE8allocateEmPKv .text.hot._ZNSt15__new_allocatorISt6vectorImSaImEEE8allocateEmPKv)
    *(.text._ZNSt10_HashtableImSt4pairIKmiESaIS2_ENSt8__detail10_Select1stESt8equal_toImESt4hashImENS4_18_Mod_range_hashingENS4_20_Default_ranged_hashENS4_20_Prime_rehash_policyENS4_17_Hashtable_traitsILb0ELb0ELb1EEEE6rehashEm .text.unlikely._ZNSt10_HashtableImSt4pairIKmiESaIS2_ENSt8__detail10_Select1stESt8equal_toImESt4hashImENS4_18_Mod_range_hashingENS4_20_Default_ranged_hashENS4_20_Prime_rehash_policyENS4_17_Hashtable_traitsILb0ELb0ELb1EEEE6rehashEm .text.hot._ZNSt10_HashtableImSt4pairIKmiESaIS2_ENSt8__detail10_Select1stESt8equal_toImESt4hashImENS4_18_Mod_range_hashingENS4_20_Default_ranged_hashENS4_20_Prime_rehash_policyENS4_17_Hashtable_traitsILb0ELb0ELb1EEEE6rehashEm)
    *(.text._ZNSt10_HashtableImSt4pairIKmiESaIS2_ENSt8__detail10_Select1stESt8equal_toImESt4hashImENS4_18_Mod_range_hashingENS4_20_Default_ranged_hashENS4_20_Prime_rehash_policyENS4_17_Hashtable_traitsILb0ELb0ELb1EEEE13_M_rehash_auxEmSt17integral_constantIbLb1EE .text.unlikely._ZNSt10_HashtableImSt4pairIKmiESaIS2_ENSt8__detail10_Select1stESt8equal_toImESt4hashImENS4_18_Mod_range_hashingENS4_20_Default_ranged_hashENS4_20_Prime_rehash_policyENS4_17_Hashtable_traitsILb0ELb0ELb1EEEE13_M_rehash_auxEmSt17integral_constantIbLb1EE .text.hot._ZNSt10_HashtableImSt4pairIKmiESaIS2_ENSt8__detail10_Select1stESt8equal_toImESt4hashImENS4_18_Mod_range_hashingENS4_20_Default_ranged_hashENS4_20_Prime_rehash_policyENS4_17_Hashtable_traitsILb0ELb0ELb1EEEE13_M_rehash_auxEmSt17integral_constantIbLb1EE)
    *(.text._ZNSt8__detail9_Map_baseImSt4pairIKmiESaIS3_ENS_10_Select1stESt8equal_toImESt4hashImENS_18_Mod_range_hashingENS_20_Default_ranged_hashENS_20_Prime_rehash_policyENS_17_Hashtable_traitsILb0ELb0ELb1EEELb1EEixERS2_ .text.unlikely._ZNSt8__detail9_Map_baseImSt4pairIKmiESaIS3_ENS_10_Select1stESt8equal_toImESt4hashImENS_18_Mod_range_hashingENS_20_Default_ranged_hashENS_20_Prime_rehash_policyENS_17_Hashtable_traitsILb0ELb0ELb1EEELb1EEixERS2_ .text.hot._ZNSt8__detail9_Map_baseImSt4pairIKmiESaIS3_ENS_10_Select1stESt8equal_toImESt4hashImENS_18_Mod_range_hashingENS_20_Default_ranged_hashENS_20_Prime_rehash_policyENS_17_Hashtable_traitsILb0ELb0ELb1EEELb1EEixERS2_)
    *(.text._ZNKSt10_HashtableImSt4pairIKmiESaIS2_ENSt8__detail10_Select1stESt8equal_toImESt4hashImENS4_18_Mod_range_hashingENS4_20_Default_ranged_hashENS4_20_Prime_rehash_policyENS4_17_Hashtable_traitsILb0ELb0ELb1EEEE12_M_find_nodeEmRS1_m .text.unlikely._ZNKSt10_HashtableImSt4pairIKmiESaIS2_ENSt8__detail10_Select1stESt8equal_toImESt4hashImENS4_18_Mod_range_hashingENS4_20_Default_ranged_hashENS4_20_Prime_rehash_policyENS4_17_Hashtable_traitsILb0ELb0ELb1EEEE12_M_find_nodeEmRS1_m .text.hot._ZNKSt10_HashtableImSt4pairIKmiESaIS2_ENSt8__detail10_Select1stESt8equal_toImESt4hashImENS4_18_Mod_range_hashingENS4_20_Default_ranged_hashENS4_20_Prime_rehash_policyENS4_17_Hashtable_traitsILb0ELb0ELb1EEEE12_M_find_nodeEmRS1_m)
    *(.text._ZNSt10_HashtableImSt4pairIKmiESaIS2_ENSt8__detail10_Select1stESt8equal_toImESt4hashImENS4_18_Mod_range_hashingENS4_20_Default_ranged_hashENS4_20_Prime_rehash_policyENS4_17_Hashtable_traitsILb0ELb0ELb1EEEE21_M_insert_unique_nodeEmmPNS4_10_Hash_nodeIS2_Lb0EEEm .text.unlikely._ZNSt10_HashtableImSt4pairIKmiESaIS2_ENSt8__detail10_Select1stESt8equal_toImESt4hashImENS4_18_Mod_range_hashingENS4_20_Default_ranged_hashENS4_20_Prime_rehash_policyENS4_17_Hashtable_traitsILb0ELb0ELb1EEEE21_M_insert_unique_nodeEmmPNS4_10_Hash_nodeIS2_Lb0EEEm .text.hot._ZNSt10_HashtableImSt4pairIKmiESaIS2_ENSt8__detail10_Select1stESt8equal_toImESt4hashImENS4_18_Mod_range_hashingENS4_20_Default_ranged_hashENS4_20_Prime_rehash_policyENS4_17_Hashtable_traitsILb0ELb0ELb1EEEE21_M_insert_unique_nodeEmmPNS4_10_Hash_nodeIS2_Lb0EEEm)
    *(.text._ZNSt10_HashtableImSt4pairIKmiESaIS2_ENSt8__detail10_Select1stESt8equal_toImESt4hashImENS4_18_Mod_range_hashingENS4_20_Default_ranged_hashENS4_20_Prime_rehash_policyENS4_17_Hashtable_traitsILb0ELb0ELb1EEEE10_M_emplaceIJRS1_iEEES0_INS4_14_Node_iteratorIS2_Lb0ELb0EEEbESt17integral_constantIbLb1EEDpOT_ .text.unlikely._ZNSt10_HashtableImSt4pairIKmiESaIS2_ENSt8__detail10_Select1stESt8equal_toImESt4hashImENS4_18_Mod_range_hashingENS4_20_Default_ranged_hashENS4_20_Prime_rehash_policyENS4_17_Hashtable_traitsILb0ELb0ELb1EEEE10_M_emplaceIJRS1_iEEES0_INS4_14_Node_iteratorIS2_Lb0ELb0EEEbESt17integral_constantIbLb1EEDpOT_ .text.hot._ZNSt10_HashtableImSt4pairIKmiESaIS2_ENSt8__detail10_Select1stESt8equal_toImESt4hashImENS4_18_Mod_range_hashingENS4_20_Default_ranged_hashENS4_20_Prime_rehash_policyENS4_17_Hashtable_traitsILb0ELb0ELb1EEEE10_M_emplaceIJRS1_iEEES0_INS4_14_Node_iteratorIS2_Lb0ELb0EEEbESt17integral_constantIbLb1EEDpOT_)
    *(.text._ZNSt10_HashtableImSt4pairIKmiESaIS2_ENSt8__detail10_Select1stESt8equal_toImESt4hashImENS4_18_Mod_range_hashingENS4_20_Default_ranged_hashENS4_20_Prime_rehash_policyENS4_17_Hashtable_traitsILb0ELb0ELb1EEEE4findERS1_ .text.unlikely._ZNSt10_HashtableImSt4pairIKmiESaIS2_ENSt8__detail10_Select1stESt8equal_toImESt4hashImENS4_18_Mod_range_hashingENS4_20_Default_ranged_hashENS4_20_Prime_rehash_policyENS4_17_Hashtable_traitsILb0ELb0ELb1EEEE4findERS1_ .text.hot._ZNSt10_HashtableImSt4pairIKmiESaIS2_ENSt8__detail10_Select1stESt8equal_toImESt4hashImENS4_18_Mod_range_hashingENS4_20_Default_ranged_hashENS4_20_Prime_rehash_policyENS4_17_Hashtable_traitsILb0ELb0ELb1EEEE4findERS1_)
    *(.text._ZNSt6vectorImSaImEE17_M_realloc_insertIJmEEEvN9__gnu_cxx17__normal_iteratorIPmS1_EEDpOT_ .text.unlikely._ZNSt6vectorImSaImEE17_M_realloc_insertIJmEEEvN9__gnu_cxx17__normal_iteratorIPmS1_EEDpOT_ .text.hot._ZNSt6vectorImSaImEE17_M_realloc_insertIJmEEEvN9__gnu_cxx17__normal_iteratorIPmS1_EEDpOT_)
    *(.text._ZN3ordL6IlnQ57Em .text.unlikely._ZN3ordL6IlnQ57Em .text.hot._ZN3ordL6IlnQ57Em)
    *(.text._ZNSt6vectorIlSaIlEE14_M_fill_assignEmRKl .text.unlikely._ZNSt6vectorIlSaIlEE14_M_fill_assignEmRKl .text.hot._ZNSt6vectorIlSaIlEE14_M_fill_assignEmRKl)
    *(.text._ZNSt6vectorIlSaIlEEC2EmRKlRKS0_ .text.unlikely._ZNSt6vectorIlSaIlEEC2EmRKlRKS0_ .text.hot._ZNSt6vectorIlSaIlEEC2EmRKlRKS0_)
    *(.text._ZSt13__adjust_heapIN9__gnu_cxx17__normal_iteratorIPiSt6vectorIiSaIiEEEEliNS0_5__ops15_Iter_comp_iterIZN3ordL13DecodeOrderV3EPKcSB_PS5_E3$_0EEEvT_T0_SG_T1_T2_ .text.unlikely._ZSt13__adjust_heapIN9__gnu_cxx17__normal_iteratorIPiSt6vectorIiSaIiEEEEliNS0_5__ops15_Iter_comp_iterIZN3ordL13DecodeOrderV3EPKcSB_PS5_E3$_0EEEvT_T0_SG_T1_T2_ .text.hot._ZSt13__adjust_heapIN9__gnu_cxx17__normal_iteratorIPiSt6vectorIiSaIiEEEEliNS0_5__ops15_Iter_comp_iterIZN3ordL13DecodeOrderV3EPKcSB_PS5_E3$_0EEEvT_T0_SG_T1_T2_)
    *(.text._ZNSt6thread11_State_implINS_8_InvokerISt5tupleIJPFvvEEEEEED0Ev .text.unlikely._ZNSt6thread11_State_implINS_8_InvokerISt5tupleIJPFvvEEEEEED0Ev .text.hot._ZNSt6thread11_State_implINS_8_InvokerISt5tupleIJPFvvEEEEEED0Ev)
    *(.text._ZNSt6vectorINSt7__cxx1112basic_stringIcSt11char_traitsIcESaIcEEESaIS5_EE19_M_range_initializeIPKS5_EEvT_SB_St20forward_iterator_tag .text.unlikely._ZNSt6vectorINSt7__cxx1112basic_stringIcSt11char_traitsIcESaIcEEESaIS5_EE19_M_range_initializeIPKS5_EEvT_SB_St20forward_iterator_tag .text.hot._ZNSt6vectorINSt7__cxx1112basic_stringIcSt11char_traitsIcESaIcEEESaIS5_EE19_M_range_initializeIPKS5_EEvT_SB_St20forward_iterator_tag)
    *(.text._ZNSt8__detail9_Map_baseIiSt4pairIKiiESaIS3_ENS_10_Select1stESt8equal_toIiESt4hashIiENS_18_Mod_range_hashingENS_20_Default_ranged_hashENS_20_Prime_rehash_policyENS_17_Hashtable_traitsILb0ELb0ELb1EEELb1EEixERS2_ .text.unlikely._ZNSt8__detail9_Map_baseIiSt4pairIKiiESaIS3_ENS_10_Select1stESt8equal_toIiESt4hashIiENS_18_Mod_range_hashingENS_20_Default_ranged_hashENS_20_Prime_rehash_policyENS_17_Hashtable_traitsILb0ELb0ELb1EEELb1EEixERS2_ .text.hot._ZNSt8__detail9_Map_baseIiSt4pairIKiiESaIS3_ENS_10_Select1stESt8equal_toIiESt4hashIiENS_18_Mod_range_hashingENS_20_Default_ranged_hashENS_20_Prime_rehash_policyENS_17_Hashtable_traitsILb0ELb0ELb1EEELb1EEixERS2_)
    *(.text._ZNKSt10_HashtableIiSt4pairIKiiESaIS2_ENSt8__detail10_Select1stESt8equal_toIiESt4hashIiENS4_18_Mod_range_hashingENS4_20_Default_ranged_hashENS4_20_Prime_rehash_policyENS4_17_Hashtable_traitsILb0ELb0ELb1EEEE12_M_find_nodeEmRS1_m .text.unlikely._ZNKSt10_HashtableIiSt4pairIKiiESaIS2_ENSt8__detail10_Select1stESt8equal_toIiESt4hashIiENS4_18_Mod_range_hashingENS4_20_Default_ranged_hashENS4_20_Prime_rehash_policyENS4_17_Hashtable_traitsILb0ELb0ELb1EEEE12_M_find_nodeEmRS1_m .text.hot._ZNKSt10_HashtableIiSt4pairIKiiESaIS2_ENSt8__detail10_Select1stESt8equal_toIiESt4hashIiENS4_18_Mod_range_hashingENS4_20_Default_ranged_hashENS4_20_Prime_rehash_policyENS4_17_Hashtable_traitsILb0ELb0ELb1EEEE12_M_find_nodeEmRS1_m)
    *(.text._ZNSt10_HashtableIiSt4pairIKiiESaIS2_ENSt8__detail10_Select1stESt8equal_toIiESt4hashIiENS4_18_Mod_range_hashingENS4_20_Default_ranged_hashENS4_20_Prime_rehash_policyENS4_17_Hashtable_traitsILb0ELb0ELb1EEEE21_M_insert_unique_nodeEmmPNS4_10_Hash_nodeIS2_Lb0EEEm .text.unlikely._ZNSt10_HashtableIiSt4pairIKiiESaIS2_ENSt8__detail10_Select1stESt8equal_toIiESt4hashIiENS4_18_Mod_range_hashingENS4_20_Default_ranged_hashENS4_20_Prime_rehash_policyENS4_17_Hashtable_traitsILb0ELb0ELb1EEEE21_M_insert_unique_nodeEmmPNS4_10_Hash_nodeIS2_Lb0EEEm .text.hot._ZNSt10_HashtableIiSt4pairIKiiESaIS2_ENSt8__detail10_Select1stESt8equal_toIiESt4hashIiENS4_18_Mod_range_hashingENS4_20_Default_ranged_hashENS4_20_Prime_rehash_policyENS4_17_Hashtable_traitsILb0ELb0ELb1EEEE21_M_insert_unique_nodeEmmPNS4_10_Hash_nodeIS2_Lb0EEEm)
    *(.text._ZNSt10_HashtableIiSt4pairIKiiESaIS2_ENSt8__detail10_Select1stESt8equal_toIiESt4hashIiENS4_18_Mod_range_hashingENS4_20_Default_ranged_hashENS4_20_Prime_rehash_policyENS4_17_Hashtable_traitsILb0ELb0ELb1EEEE13_M_rehash_auxEmSt17integral_constantIbLb1EE .text.unlikely._ZNSt10_HashtableIiSt4pairIKiiESaIS2_ENSt8__detail10_Select1stESt8equal_toIiESt4hashIiENS4_18_Mod_range_hashingENS4_20_Default_ranged_hashENS4_20_Prime_rehash_policyENS4_17_Hashtable_traitsILb0ELb0ELb1EEEE13_M_rehash_auxEmSt17integral_constantIbLb1EE .text.hot._ZNSt10_HashtableIiSt4pairIKiiESaIS2_ENSt8__detail10_Select1stESt8equal_toIiESt4hashIiENS4_18_Mod_range_hashingENS4_20_Default_ranged_hashENS4_20_Prime_rehash_policyENS4_17_Hashtable_traitsILb0ELb0ELb1EEEE13_M_rehash_auxEmSt17integral_constantIbLb1EE)
    *(.text._ZN11dict_derive18BuildDictFromInputEPKcS1_S1_ .text.unlikely._ZN11dict_derive18BuildDictFromInputEPKcS1_S1_ .text.hot._ZN11dict_derive18BuildDictFromInputEPKcS1_S1_)
    *(.text._ZN11dict_derive12_GLOBAL__N_14SortEPjjPFbjjE .text.unlikely._ZN11dict_derive12_GLOBAL__N_14SortEPjjPFbjjE .text.hot._ZN11dict_derive12_GLOBAL__N_14SortEPjjPFbjjE)
    *(.text._ZN11dict_derive12_GLOBAL__N_19ScoreLessEjj .text.unlikely._ZN11dict_derive12_GLOBAL__N_19ScoreLessEjj .text.hot._ZN11dict_derive12_GLOBAL__N_19ScoreLessEjj)
    *(.text._ZN11dict_derive12_GLOBAL__N_18ArenaPutEPKcm .text.unlikely._ZN11dict_derive12_GLOBAL__N_18ArenaPutEPKcm .text.hot._ZN11dict_derive12_GLOBAL__N_18ArenaPutEPKcm)
    *(.text._ZN11dict_derive12_GLOBAL__N_17CountOfEPKcPj .text.unlikely._ZN11dict_derive12_GLOBAL__N_17CountOfEPKcPj .text.hot._ZN11dict_derive12_GLOBAL__N_17CountOfEPKcPj)
    *(.text._ZN11dict_derive12_GLOBAL__N_17OrdLessEjj .text.unlikely._ZN11dict_derive12_GLOBAL__N_17OrdLessEjj .text.hot._ZN11dict_derive12_GLOBAL__N_17OrdLessEjj)
    *(.text._ZN11dict_derive12_GLOBAL__N_17RevLessEjj .text.unlikely._ZN11dict_derive12_GLOBAL__N_17RevLessEjj .text.hot._ZN11dict_derive12_GLOBAL__N_17RevLessEjj)
    *(.text._ZN11dict_derive12_GLOBAL__N_16BumpExEPKcmi .text.unlikely._ZN11dict_derive12_GLOBAL__N_16BumpExEPKcmi .text.hot._ZN11dict_derive12_GLOBAL__N_16BumpExEPKcmi)
    *(.text._ZN11dict_derive12_GLOBAL__N_19ScanPairsEPKcjPmPj .text.unlikely._ZN11dict_derive12_GLOBAL__N_19ScanPairsEPKcjPmPj .text.hot._ZN11dict_derive12_GLOBAL__N_19ScanPairsEPKcjPmPj)
    *(.text._ZN11dict_derive12_GLOBAL__N_17SortU64EPmm .text.unlikely._ZN11dict_derive12_GLOBAL__N_17SortU64EPmm .text.hot._ZN11dict_derive12_GLOBAL__N_17SortU64EPmm)
    *(.text._ZN11dict_derive12_GLOBAL__N_17Log2Q16Em .text.unlikely._ZN11dict_derive12_GLOBAL__N_17Log2Q16Em .text.hot._ZN11dict_derive12_GLOBAL__N_17Log2Q16Em)
    *(.text._ZN11dict_derive12_GLOBAL__N_17SegSlotEmm .text.unlikely._ZN11dict_derive12_GLOBAL__N_17SegSlotEmm .text.hot._ZN11dict_derive12_GLOBAL__N_17SegSlotEmm)
    *(.text._ZN11dict_derive12_GLOBAL__N_15TFindEPKcmi .text.unlikely._ZN11dict_derive12_GLOBAL__N_15TFindEPKcmi .text.hot._ZN11dict_derive12_GLOBAL__N_15TFindEPKcmi)
    *(.text._ZN11dict_derive12_GLOBAL__N_15WFindEPKcm .text.unlikely._ZN11dict_derive12_GLOBAL__N_15WFindEPKcm .text.hot._ZN11dict_derive12_GLOBAL__N_15WFindEPKcm)
    *(.text._ZN7EncoderC1EPSt14basic_ofstreamIcSt11char_traitsIcEEP9Predictor .text.unlikely._ZN7EncoderC1EPSt14basic_ofstreamIcSt11char_traitsIcEEP9Predictor .text.hot._ZN7EncoderC1EPSt14basic_ofstreamIcSt11char_traitsIcEEP9Predictor)
    *(.text._ZN7Encoder6EncodeEi .text.unlikely._ZN7Encoder6EncodeEi .text.hot._ZN7Encoder6EncodeEi)
    *(.text._ZNSt6vectorIcSaIcEE17_M_realloc_insertIJcEEEvN9__gnu_cxx17__normal_iteratorIPcS1_EEDpOT_ .text.unlikely._ZNSt6vectorIcSaIcEE17_M_realloc_insertIJcEEEvN9__gnu_cxx17__normal_iteratorIPcS1_EEDpOT_ .text.hot._ZNSt6vectorIcSaIcEE17_M_realloc_insertIJcEEEvN9__gnu_cxx17__normal_iteratorIPcS1_EEDpOT_)
    *(.text._ZN7Encoder5FlushEv .text.unlikely._ZN7Encoder5FlushEv .text.hot._ZN7Encoder5FlushEv)
    
    *(.text._Z5StoreRKNSt7__cxx1112basic_stringIcSt11char_traitsIcESaIcEEES6_S6_P8_IO_FILEPyS9_ .text.unlikely._Z5StoreRKNSt7__cxx1112basic_stringIcSt11char_traitsIcESaIcEEES6_S6_P8_IO_FILEPyS9_ .text.hot._Z5StoreRKNSt7__cxx1112basic_stringIcSt11char_traitsIcESaIcEEES6_S6_P8_IO_FILEPyS9_)
    *(.text._ZN7Encoder9WriteByteEj .text.unlikely._ZN7Encoder9WriteByteEj .text.hot._ZN7Encoder9WriteByteEj)
    *(.text._ZN7Encoder16ObserveKnownByteEj .text.unlikely._ZN7Encoder16ObserveKnownByteEj .text.hot._ZN7Encoder16ObserveKnownByteEj)
    *(.text._Z17WriteHeaderVocfixybPSt14basic_ofstreamIcSt11char_traitsIcEE .text.unlikely._Z17WriteHeaderVocfixybPSt14basic_ofstreamIcSt11char_traitsIcEE .text.hot._Z17WriteHeaderVocfixybPSt14basic_ofstreamIcSt11char_traitsIcEE)
    *(.text._ZN12vocab_frozen9PutHeaderEP8_IO_FILEij .text.unlikely._ZN12vocab_frozen9PutHeaderEP8_IO_FILEij .text.hot._ZN12vocab_frozen9PutHeaderEP8_IO_FILEij)
    *(.text._ZNK12preprocessor11FastWordMap4FindEPKcjPj .text.unlikely._ZNK12preprocessor11FastWordMap4FindEPKcjPj .text.hot._ZNK12preprocessor11FastWordMap4FindEPKcjPj)
    *(.text._ZL7g1_findPKcmmS0_m .text.unlikely._ZL7g1_findPKcmmS0_m .text.hot._ZL7g1_findPKcmmS0_m)
    *(.text._ZL17provide_dict_filePKc .text.unlikely._ZL17provide_dict_filePKc .text.hot._ZL17provide_dict_filePKc)

    
    *(.text._ZN14metablock_form4PackERKNSt7__cxx1112basic_stringIcSt11char_traitsIcESaIcEEE .text.unlikely._ZN14metablock_form4PackERKNSt7__cxx1112basic_stringIcSt11char_traitsIcESaIcEEE .text.hot._ZN14metablock_form4PackERKNSt7__cxx1112basic_stringIcSt11char_traitsIcESaIcEEE)
    *(.text._ZN14metablock_formL4FestEPSt6vectorIhSaIhEExi .text.unlikely._ZN14metablock_formL4FestEPSt6vectorIhSaIhEExi .text.hot._ZN14metablock_formL4FestEPSt6vectorIhSaIhEExi)
    *(.text._ZN7ip_pack4PackERKNSt7__cxx1112basic_stringIcSt11char_traitsIcESaIcEEE .text.unlikely._ZN7ip_pack4PackERKNSt7__cxx1112basic_stringIcSt11char_traitsIcESaIcEEE .text.hot._ZN7ip_pack4PackERKNSt7__cxx1112basic_stringIcSt11char_traitsIcESaIcEEE)
    *(.text._ZN7ip_pack7KodiereEPKhPh .text.unlikely._ZN7ip_pack7KodiereEPKhPh .text.hot._ZN7ip_pack7KodiereEPKhPh)
    *(.text._ZN7ip_pack6LiesIpEPKhmmPh .text.unlikely._ZN7ip_pack6LiesIpEPKhmmPh .text.hot._ZN7ip_pack6LiesIpEPKhmmPh)
    *(.text._ZN7ip_pack5WachtEbyy .text.unlikely._ZN7ip_pack5WachtEbyy .text.hot._ZN7ip_pack5WachtEbyy)
    
    
    *(.text._ZN3ord9ORDV3Vote6RecentEiRKSt6vectorIiSaIiEE .text.unlikely._ZN3ord9ORDV3Vote6RecentEiRKSt6vectorIiSaIiEE .text.hot._ZN3ord9ORDV3Vote6RecentEiRKSt6vectorIiSaIiEE)
    *(.text._ZN3ord9ORDV3Vote3AddEil .text.unlikely._ZN3ord9ORDV3Vote3AddEil .text.hot._ZN3ord9ORDV3Vote3AddEil)
    *(.rodata._ZN3ordL7kKalTxtE)
    *(.rodata._ZN3ord9Extractor5TitleEPKcS2_)
  }
} INSERT AFTER .got.plt;
